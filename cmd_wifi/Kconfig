## cmd_wifi/Kconfig
```kconfig
menu "Console WiFi commands (cmd_wifi)"
    depends on ESP_WIFI_ENABLED || ESP_HOST_WIFI_ENABLED

    config CMD_WIFI_KNOWN_NVS_NAMESPACE
        string "NVS namespace for saved networks"
        default "wifi_known"
        help
            NVS namespace holding the saved-network blob (key "known"). At most 15
            characters. r2_domeplayer's store used "r2net"; the blob layout is the same,
            so setting this to "r2net" keeps a board's saved networks across the switch.

    config CMD_WIFI_KNOWN_FAST_RETRIES
        int "Immediate reconnect attempts after the link drops"
        default 5
        range 0 50

    config CMD_WIFI_KNOWN_RETRY_INTERVAL_S
        int "Seconds between slow reconnect attempts (0 = stop after the immediate ones)"
        default 30
        range 0 3600
        help
            Once the immediate attempts are used up -- or a join fails for a reason other
            than authentication -- one reconnect is tried every this many seconds while
            WiFi is on, so the board recovers by itself when its access point returns.

    config CMD_WIFI_AP_SSID_PREFIX
        string "Access point SSID prefix"
        default "esp"
        help
            `wifi ap` names the access point <prefix>-xxxx, xxxx the last two bytes of the
            station MAC, until `wifi ap --ssid` stores another name.

    config CMD_WIFI_AP_MAX_CONN
        int "Access point: most stations at once"
        default 4
        range 1 10

    config CMD_WIFI_AP_CAPTIVE_DNS
        bool "Access point: answer every DNS name with the board (captive portal)"
        default y
        help
            A phone that joins the access point checks for internet by fetching a known page;
            answering every name with the board makes that land on the board's web page, and
            the phone offers to open it. Off, the DHCP server offers no captive-portal URL
            either and no DNS responder runs: for a board with no web page.

endmenu
```

## servo/Kconfig
```kconfig
menu "Servo driver (servo)"

    config SERVO_TASK_STACK_IN_PSRAM
        bool "Servo task stack in PSRAM"
        depends on SPIRAM
        default n
        help
            The frame task's 4 KB stack from PSRAM instead of internal RAM. Safe only
            while nothing on the task touches flash: every flash operation, reads
            included, asserts an internal stack. The task flushes the controllers over
            I2C, runs Servo::Tick() and calls the output listener; settings are loaded
            and saved on the callers of the C API, never here. An application whose
            output listener reads or writes NVS must leave this off. The I2C traffic is
            fine, because the I2C interrupt is not IRAM-safe (CONFIG_I2C_ISR_IRAM_SAFE)
            and so never runs while the cache is off.

endmenu
```

## web_server/Kconfig
```kconfig
menu "Web server (web_server)"

    config WEB_SERVER_MAX_ROUTES
        int "Most API routes"
        default 32
        range 8 96
        help
            Routes registered with web_register(), the built-in ones included. Pages are
            served without a route each.

    config WEB_SERVER_MAX_SOCKETS
        int "Most open connections"
        default 7
        range 3 13
        help
            The server keeps three more sockets for itself: CONFIG_LWIP_MAX_SOCKETS must
            cover these, those three, and everything else the application opens.

    config WEB_SERVER_STACK_SIZE
        int "Server task stack"
        default 6144

    config WEB_SERVER_UPLOAD_STACK_SIZE
        int "Long-operation task stack"
        default 6144
        help
            An upload, a download, a copy or a scan runs on a task of its own, so the server
            keeps answering (web_job_run()).

    config WEB_SERVER_PULL_STACK_SIZE
        int "Download task stack"
        default 8192
        help
            A pull runs on a task of its own. TLS wants most of it.

    config WEB_SERVER_CORS_ORIGINS
        string "Sites whose pages may call the API (CORS), space-separated"
        default ""
        help
            Origins -- scheme://host[:port] -- allowed to call the API from a browser: an API
            tool such as https://editor.swagger.io, or a project's documentation site.
            https://*.example.com allows every subdomain of example.com (not example.com
            itself: list both). `*` allows any site. Empty: none but the board's own pages.
            `web cors` on the console changes the list, kept in NVS; `web cors reset` comes
            back to this one. An allowed site can drive the board unless a password is set.

    config WEB_SERVER_CORS_MAX_LEN
        int "Most characters in the CORS list"
        default 384
        range 64 1024

endmenu
```
