## canbus/Kconfig
```kconfig
menu "CAN (canbus)"

    config CANBUS_RX_QUEUE_LEN
        int "Frames the receive queue holds"
        default 256
        range 16 1024
        help
            Between the controller's interrupt and whoever reads the frames (the `can` command,
            or the Cyphal node). 24 bytes each, in internal RAM, from the first start on.

            A flash write holds the reader off while the interrupt goes on filling the queue:
            an erase runs for up to CONFIG_SPI_FLASH_ERASE_YIELD_DURATION_MS (20 ms) before it
            yields. Measured 2026-11-20 with a bus saturated at 1 Mbit/s by 8-byte frames
            (about 8,100 a second) during a 1 MB LittleFS write (`fs bench 1024`): the queue
            held 155 and 164 frames at most in two runs, and a 128-frame queue dropped 997 frames
            over the write (holo-player-fw's ESP32-S3). On the dome panel's ESP32-P4 (2026-11-21),
            a bus saturated by the adapter at ~8,800 frames a second across 100 console commands,
            each seven 4 KB erases, held 20 at most and dropped none. 256 covers both with room.
            A bus saturated with shorter frames (up to about 21,000 a second with no data) would
            need more; a Cyphal bus is normally far lighter.

    config CANBUS_TX_QUEUE_LEN
        int "Frames waiting to be sent"
        default 16
        range 2 255
        help
            Frames given to canbus_send() and not yet on the bus. When they are all waiting
            (nobody acknowledging, or bus-off), canbus_send() waits for room or times out. The `can`
            command uses them all; the Cyphal node one (canbus_config_t.tx_slots), keeping its
            own queue in priority order in front.

    config CANBUS_CMD_TASK_STACK
        int "`can` reader task: stack (bytes)"
        default 3072
        range 2048 16384
        help
            The task `can start` makes to read the receive queue, echo and print. Internal RAM,
            from `can start` to `can stop` only. 3072 is what it has run on since it was written.
            Measured on the ESP32-P4 (2026-11-22, `tasks` after 17,000 frames echoed with `can
            dump` printing 3,000 of them): 2268 bytes left at the low-water mark, so ~800 used.

    config CANBUS_CMD_TASK_PRIO
        int "`can` reader task: priority"
        default 6
        range 1 24
        help
            Above the console's, so an echo is not held behind a command the console is
            printing. The default is the first application's (holo-player-fw), where it sits
            over that board's video player at 5.

    config CANBUS_CMD_TASK_CORE
        int "`can` reader task: core"
        default 0
        range 0 1
        help
            Core 0 is the console's on both targets; the first application (holo-player-fw)
            keeps core 1 for its video player.

endmenu
```

## cmd_i2c/Kconfig
```kconfig
menu "I2C tools (cmd_i2c)"

    config CMD_I2C_DEFAULT_PORT
        int "I2C port the i2c commands use until i2cconfig says otherwise"
        range 0 2
        default 0
        help
            `i2cdetect`, `i2cget`, `i2cset` and `i2cdump` borrow the application's master
            bus on this port if it exists when they first run; `i2cconfig --port` changes
            it at run time. A board whose peripherals are not on port 0 (the ESP32-P4 dome
            panel keeps its droid devices on I2C1) sets this so the tools look there.

endmenu
```

## cmd_wifi/Kconfig
```kconfig
# The saved networks' namespace is a fact about the board's NVS, radio or no radio: the
# configuration backup (cmd_nvs/nvs_backup.c) excludes the credential blob by this name on
# every build, and a firmware built without WiFi still imports and exports the NVS that a
# WiFi build of the same board wrote. So it is NOT under the menu's radio gate below.
config CMD_WIFI_KNOWN_NVS_NAMESPACE
    string "NVS namespace for saved WiFi networks"
    default "wifi_known"
    help
        NVS namespace holding the saved-network blob (key "known"). At most 15
        characters. r2_domeplayer's store used "r2net"; the blob layout is the same,
        so setting this to "r2net" keeps a board's saved networks across the switch.
        Visible without a radio because the configuration backup's exclusion of the
        blob is keyed on it (2026-11-03: an ESP32-P4 build with no WiFi exported a
        saved network because this symbol did not exist there).

menu "Console WiFi commands (cmd_wifi)"
    depends on ESP_WIFI_ENABLED || ESP_HOST_WIFI_ENABLED || ESP_WIFI_REMOTE_ENABLED

    config CMD_WIFI_KNOWN_FAST_RETRIES
        int "Immediate reconnect attempts after the link drops"
        default 5
        range 0 50

    config CMD_WIFI_KNOWN_RETRY_INTERVAL_S
        int "Seconds between slow reconnect attempts (0 = stop after the immediate ones)"
        default 30
        range 0 3600
        help
            Once the immediate attempts are used up -- or a join fails for a reason other
            than authentication -- one reconnect is tried every this many seconds while
            WiFi is on, so the board recovers by itself when its access point returns.

    config CMD_WIFI_AP_SSID_PREFIX
        string "Access point SSID prefix"
        default "esp"
        help
            `wifi ap` names the access point <prefix>-xxxx, xxxx the last two bytes of the
            station MAC, until `wifi ap --ssid` stores another name.

    config CMD_WIFI_AP_MAX_CONN
        int "Access point: most stations at once"
        default 4
        range 1 10

    config CMD_WIFI_AP_CAPTIVE_DNS
        bool "Access point: answer every DNS name with the board (captive portal)"
        default y
        help
            A phone that joins the access point checks for internet by fetching a known page;
            answering every name with the board makes that land on the board's web page, and
            the phone offers to open it. Off, the DHCP server offers no captive-portal URL
            either and no DNS responder runs: for a board with no web page.

endmenu
```
